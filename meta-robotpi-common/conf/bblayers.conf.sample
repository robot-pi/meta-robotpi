## meta-robotpi-common/conf/bblayers.conf.sample
```bitbake
# robotpi_layer_priorities
BBFILE_PRIORITY_robotpi-common-layer_forcevariable = "51"
BBFILE_PRIORITY_robotpi-ros-layer_forcevariable = "52"
BBFILE_PRIORITY_robotpi-tools-layer_forcevariable = "53"

# ros2_layer_priorities
BBFILE_PRIORITY_ros-common-layer_forcevariable = "37"
BBFILE_PRIORITY_ros2-layer_forcevariable = "38"
BBFILE_PRIORITY_ros2-humble-layer_forcevariable = "39"

# yocto_base_layer_priorities
BBFILE_PRIORITY_core_forcevariable = "5"
BBFILE_PRIORITY_openembedded-layer_forcevariable = "10"
BBFILE_PRIORITY_networking-layer_forcevariable = "11"
BBFILE_PRIORITY_meta-python_forcevariable = "13"

# yocto_tool_priorities
BBFILE_PRIORITY_clang-layer_forcevariable = "15"
BBFILE_PRIORITY_qt5-layer_forcevariable = "16"

BBLAYERS ?= " \
  ${TOPDIR}/../layers/meta-clang \
  ${TOPDIR}/../layers/meta-openembedded/meta-networking \
  ${TOPDIR}/../layers/meta-openembedded/meta-oe \
  ${TOPDIR}/../layers/meta-openembedded/meta-python \
  ${TOPDIR}/../layers/meta-qt5 \
  ${TOPDIR}/../layers/meta-robotpi/meta-robotpi-common \
  ${TOPDIR}/../layers/meta-robotpi/meta-robotpi-ros \
  ${TOPDIR}/../layers/meta-robotpi/meta-robotpi-tools \
  ${TOPDIR}/../layers/meta-ros/meta-ros-common \
  ${TOPDIR}/../layers/meta-ros/meta-ros2 \
  ${TOPDIR}/../layers/meta-ros/meta-ros2-humble \
  ${TOPDIR}/../layers/openembedded-core/meta \
  "
BBPATH ?= "${TOPDIR}"
BBFILES ??= ""
```

## meta-robotpi-common/conf/distro/include/robotpi-common.inc
```bitbake
# Robot-Pi Distro Common Include File
# Reference: https://github.com/96boards/meta-rpb/blob/kirkstone/conf/distro/include/rpb.inc


# Robotpi configs
DISTRO_NAME = "Robot-Pi OS Reference Distribution"
DISTRO_CODENAME = "robotpi"
DISTRO_VERSION = "robotpi-1.0+${ROS_DISTRO_METADATA_VERSION_MAJOR}.${ROS_DISTRO_METADATA_VERSION_MINOR}"

SDK_NAME_PREFIX = "${DISTRO}"
SDK_VENDOR = "-robotpisdk"
SDK_VERSION = "${@d.getVar('DISTRO_VERSION').replace('snapshot-${METADATA_REVISION}', 'snapshot')}"
SDK_VERSION[vardepvalue] = "${SDK_VERSION}"

TARGET_VENDOR = "-robotpi"

MAINTAINER = "Weiheng Ni <weihengni@robotpi.net>"


# Yocto uninative
require conf/distro/include/yocto-uninative.inc
INHERIT += "uninative"

# ROS common configs (overwritten by Robotpi configs)
require conf/distro/include/ros-useful-buildcfg-vars.inc

# meta-rpb references
require conf/distro/include/arm-defaults.inc
require conf/distro/include/egl.inc

# defaultsetup.inc gets includes after ${DISTRO}.conf, so we need to set it here
# to make the python below work. Local, site and auto.conf will override it.
TCMODE ?= "default"

# Enable multilib conditionally, only for aarch64 with default toolchain combination
# Other combinations aren't supported
def get_multilib_handler(d):
    features = d.getVar('TUNE_FEATURES', True).split()
    tcmode = d.getVar('TCMODE', True)
    if ('aarch64' in features) and (tcmode == "default"):
        distro_multilib = "conf/distro/include/distro-multilib.inc"
    else:
        distro_multilib = "conf/distro/include/file-cannot-be-found.inc"
    return distro_multilib

# Use a weak include to avoid to produce an error when the file cannot be found.
# It is the case when we don't want multilib enabled (e.g. on 32bit machines).
#include ${@get_multilib_handler(d)}


GCCVERSION ?= "arm-11.2"

ROBOTPI_DEFAULT_DISTRO_FEATURES = " \
    glfw \
    largefile \
    multiarch \
    opengl \
    pam \
    polkit \
    ptest \
    systemd \
    usrmerge \
    vulkan \
"
ROBOTPI_DEFAULT_EXTRA_RDEPENDS = "packagegroup-core-boot"

DISTRO_FEATURES:remove = "3g sysvinit"
DISTRO_FEATURES:append = " ${ROBOTPI_DEFAULT_DISTRO_FEATURES}"
DISTRO_EXTRA_RDEPENDS:append = " ${ROBOTPI_DEFAULT_EXTRA_RDEPENDS}"

VIRTUAL-RUNTIME_init_manager = "systemd"
PACKAGECONFIG:append:pn-systemd = " resolved networkd"
PACKAGECONFIG:append:pn-qtbase = " gles2 fontconfig examples"
PACKAGECONFIG:remove:pn-gpsd = "qt"
PACKAGECONFIG:append:pn-gstreamer1.0-plugins-bad = " kms"
PACKAGECONFIG:append:pn-ffmpeg = " sdl2"
PACKAGECONFIG:append:pn-igt-gpu-tools = " chamelium"

PREFERRED_PROVIDER_iasl-native = "acpica-native"
PREFERRED_PROVIDER_iasl = "acpica"


LICENSE_FLAGS_ACCEPTED += " \
    commercial \
    commercial_gstreamer1.0-libav \
    commercial_ffmpeg \
    commercial_x264 \
    non-commercial \
    synaptics-killswitch \
"

# Avoid to duplicate the rootfs tarball by generating both tar.gz/tar.xz
IMAGE_FSTYPES:remove = "tar.gz"

# By default, meta-ti and TI SDK ship tar.xz rootfs tarball for SD card deployment
# fastboot is preferred for deployment in automation
IMAGE_FSTYPES:append:omap-a15 = " ext4.gz"
IMAGE_FSTYPES:append:beaglebone = " ext4.gz"

INHERIT += "buildhistory"
INHERIT += "image-buildinfo"
BUILDHISTORY_COMMIT = "1"

# Enable support for automatically running a local hash equivalence server and
# instruct bitbake to use a hash equivalence aware signature generator. Hash
# equivalence improves reuse of sstate by detecting when a given sstate
# artifact can be reused as equivalent, even if the current task hash doesn't
# match the one that generated the artifact.
#
# A shared hash equivalent server can be set with "<HOSTNAME>:<PORT>" format
#
BB_SIGNATURE_HANDLER ?= "OEEquivHash"
BB_HASHSERVE ??= "auto"
```

## meta-robotpi-common/conf/distro/robotpi-wayland.conf
```bitbake
require conf/distro/include/robotpi-common.inc

DISTRO_NAME:append = " (Wayland)"

DISTRO_FEATURES:append = " wayland"
DISTRO_FEATURES:remove = "x11"

PREFERRED_PROVIDER_libgbm:omap-a15 = "libgbm"
PREFERRED_PROVIDER_libgbm-dev:omap-a15 = "libgbm-dev"
DISTROOVERRIDES = "robotpi:robotpi-wayland"
```

## meta-robotpi-common/conf/distro/robotpi.conf
```bitbake
require conf/distro/include/robotpi-common.inc

DISTRO_NAME:append = " (X11)"

DISTRO_FEATURES:append = " x11"
DISTRO_FEATURES:remove = "wayland"

DISTROOVERRIDES = "robotpi:robotpi-x11"
```

## meta-robotpi-common/conf/layer.conf
```bitbake
# We have a conf and classes directory, add to BBPATH
BBPATH =. "${LAYERDIR}:"

# We have recipes-* directories, add to BBFILES
BBFILES += "${LAYERDIR}/recipes-*/*/*.bb \
            ${LAYERDIR}/recipes-*/*/*.bbappend"

BBFILE_COLLECTIONS += "robotpi-common-layer"
BBFILE_PATTERN_robotpi-common-layer = "^${LAYERDIR}/"
BBFILE_PRIORITY_robotpi-common-layer = "5"

LAYERSERIES_COMPAT_robotpi-common-layer = "kirkstone"

# This should only be incremented on significant changes that will
# cause compatibility issues with other layers
LAYERVERSION_robotpi-common-layer = "3"

LAYERDEPENDS_robotpi-common-layer = "core ros2-layer"
```

## meta-robotpi-distro/conf/layer.conf
```bitbake
# We have a conf and classes directory, add to BBPATH
BBPATH =. "${LAYERDIR}:"

# We have recipes-* directories, add to BBFILES
BBFILES += "${LAYERDIR}/recipes-*/*/*.bb \
            ${LAYERDIR}/recipes-*/*/*.bbappend"

BBFILE_COLLECTIONS += "robotpi-distro-layer"
BBFILE_PATTERN_robotpi-distro-layer = "^${LAYERDIR}/"
BBFILE_PRIORITY_robotpi-distro-layer = "5"

LAYERSERIES_COMPAT_robotpi-distro-layer = "kirkstone"

# This should only be incremented on significant changes that will
# cause compatibility issues with other layers
LAYERVERSION_robotpi-distro-layer = "3"

LAYERDEPENDS_robotpi-distro-layer = "core ros2-layer"
```

## meta-robotpi-qcomrb5/conf/layer.conf
```bitbake
# We have a conf and classes directory, add to BBPATH
BBPATH =. "${LAYERDIR}:"

# We have recipes-* directories, add to BBFILES
BBFILES += "${LAYERDIR}/recipes-*/*/*.bb \
            ${LAYERDIR}/recipes-*/*/*.bbappend"

BBFILE_COLLECTIONS += "robotpi-qcomrb5-layer"
BBFILE_PATTERN_robotpi-qcomrb5-layer = "^${LAYERDIR}/"
BBFILE_PRIORITY_robotpi-qcomrb5-layer = "70"

LAYERSERIES_COMPAT_robotpi-qcomrb5-layer = "kirkstone"

# This should only be incremented on significant changes that will
# cause compatibility issues with other layers
LAYERVERSION_robotpi-qcomrb5-layer = "1"

LAYERDEPENDS_robotpi-qcomrb5-layer = "core qcom"
```

## meta-robotpi-raspberrypi/conf/layer.conf
```bitbake
# We have a conf and classes directory, add to BBPATH
BBPATH =. "${LAYERDIR}:"

# We have recipes-* directories, add to BBFILES
BBFILES += "${LAYERDIR}/recipes-*/*/*.bb \
            ${LAYERDIR}/recipes-*/*/*.bbappend"

BBFILE_COLLECTIONS += "robotpi-raspberrypi-layer"
BBFILE_PATTERN_robotpi-raspberrypi-layer = "^${LAYERDIR}/"
BBFILE_PRIORITY_robotpi-raspberrypi-layer = "70"

LAYERSERIES_COMPAT_robotpi-raspberrypi-layer = "kirkstone"

# This should only be incremented on significant changes that will
# cause compatibility issues with other layers
LAYERVERSION_robotpi-raspberrypi-layer = "1"

LAYERDEPENDS_robotpi-raspberrypi-layer = "core raspberrypi"
```

## meta-robotpi-ros/conf/layer.conf
```bitbake
# We have a conf and classes directory, add to BBPATH
BBPATH .= ":${LAYERDIR}"

# We have recipes-* directories, add to BBFILES
BBFILES += "${LAYERDIR}/recipes-*/*/*.bb \
            ${LAYERDIR}/recipes-*/*/*.bbappend"

BBFILE_COLLECTIONS += "robotpi-ros-layer"
BBFILE_PATTERN_robotpi-ros-layer = "^${LAYERDIR}/"
BBFILE_PRIORITY_robotpi-ros-layer = "6"

LAYERVERSION_robotpi-ros-layer = "1"

LAYERSERIES_COMPAT_robotpi-ros-layer = "kirkstone"

LAYERDEPENDS_robotpi-ros-layer = "core ros2-layer"
```

## meta-robotpi-tools/conf/layer.conf
```bitbake
# We have a conf and classes directory, add to BBPATH
BBPATH .= ":${LAYERDIR}"

# We have recipes-* directories, add to BBFILES
BBFILES += "${LAYERDIR}/recipes-*/*/*.bb \
            ${LAYERDIR}/recipes-*/*/*.bbappend"

BBFILE_COLLECTIONS += "robotpi-tools-layer"
BBFILE_PATTERN_robotpi-tools-layer = "^${LAYERDIR}/"
BBFILE_PRIORITY_robotpi-tools-layer = "7"

LAYERVERSION_robotpi-tools-layer = "1"

LAYERSERIES_COMPAT_robotpi-tools-layer = "kirkstone"

LAYERDEPENDS_robotpi-tools-layer = "core ros2-layer"
```

## meta-robotpi-ui/conf/layer.conf
```bitbake
# We have a conf and classes directory, add to BBPATH
BBPATH .= ":${LAYERDIR}"

# We have recipes-* directories, add to BBFILES
BBFILES += "${LAYERDIR}/recipes-*/*/*.bb \
            ${LAYERDIR}/recipes-*/*/*.bbappend"

BBFILE_COLLECTIONS += "robotpi-ui-layer"
BBFILE_PATTERN_robotpi-ui-layer = "^${LAYERDIR}/"
BBFILE_PRIORITY_robotpi-ui-layer = "71"

LAYERVERSION_robotpi-ui-layer = "1"

LAYERSERIES_COMPAT_robotpi-ui-layer = "kirkstone"

LAYERDEPENDS_robotpi-ui-layer = "core ros2-layer chromium-browser-layer"
```
